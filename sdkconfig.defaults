## sdkconfig.defaults
```kconfig
# ESP-IDF 默认配置
# ESP32-S3 无线 1602A LCD 显示屏项目

# ==============================
# 芯片和目标配置
# ==============================
CONFIG_IDF_TARGET="esp32s3"

# ==============================
# CPU 配置
# ==============================
CONFIG_ESP32S3_DEFAULT_CPU_FREQ_240=y
CONFIG_ESP32S3_CPU_FREQ_MHZ=240

# ==============================
# PSRAM 配置（OPI 8MB）
# ==============================
CONFIG_SPIRAM=y
CONFIG_SPIRAM_MODE_OCT=y
CONFIG_SPIRAM_SPEED_80M=y
CONFIG_SPIRAM_SIZE=8388608

# ==============================
# Flash 配置（16MB）
# ==============================
CONFIG_ESPTOOLPY_FLASHSIZE_16MB=y
CONFIG_ESPTOOLPY_FLASHMODE_QIO=y

# ==============================
# 分区表配置
# ==============================
CONFIG_PARTITION_TABLE_CUSTOM=y
CONFIG_PARTITION_TABLE_CUSTOM_FILENAME="partitions.csv"

# ==============================
# FreeRTOS 配置
# ==============================
CONFIG_FREERTOS_HZ=1000
CONFIG_FREERTOS_TIMER_TASK_STACK_SIZE=4096

# ==============================
# ESP Timer 配置
# ==============================
CONFIG_ESP_TIMER_TASK_STACK_SIZE=4096

# ==============================
# WiFi 配置
# ==============================
CONFIG_ESP_WIFI_STATIC_RX_BUFFER_NUM=10
CONFIG_ESP_WIFI_DYNAMIC_RX_BUFFER_NUM=32
CONFIG_ESP_WIFI_DYNAMIC_TX_BUFFER_NUM=32
CONFIG_ESP_WIFI_AMPDU_TX_ENABLED=y
CONFIG_ESP_WIFI_AMPDU_RX_ENABLED=y
CONFIG_ESP_WIFI_TX_BA_WIN=6
CONFIG_ESP_WIFI_RX_BA_WIN=6

# ==============================
# LWIP 配置
# ==============================
CONFIG_LWIP_MAX_SOCKETS=10

# ==============================
# HTTP 客户端配置
# ==============================
CONFIG_ESP_HTTP_CLIENT_ENABLE_HTTPS=y

# ==============================
# OTA 配置
# ==============================
CONFIG_ESP_HTTPS_OTA_ALLOW_HTTP=y

# ==============================
# 日志配置
# ==============================
CONFIG_LOG_DEFAULT_LEVEL_INFO=y
CONFIG_LOG_MAXIMUM_LEVEL_DEBUG=y

# ==============================
# 编译器优化
# ==============================
CONFIG_COMPILER_OPTIMIZATION_PERF=y

# ==============================
# 电源管理
# ==============================
CONFIG_PM_ENABLE=y
CONFIG_FREERTOS_USE_TICKLESS_IDLE=y
```
